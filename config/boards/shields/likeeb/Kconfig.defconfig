## config/boards/shields/likeeb/Kconfig.defconfig
```kconfig
if SHIELD_LIKEEB_RIGHT

config ZMK_KEYBOARD_NAME
    default "likeeb 2.0"

config ZMK_SPLIT_ROLE_CENTRAL
    default y

endif


if SHIELD_LIKEEB_LEFT || SHIELD_LIKEEB_RIGHT

config ZMK_SPLIT
    default y

endif
```

## config/boards/shields/likeeb/Kconfig.shield
```kconfig
# Copyright (c) 2022 Casey Webster, Lau Kar Rui
# SPDX-License-Identifier: MIT

config SHIELD_LIKEEB_LEFT
    def_bool $(shields_list_contains,likeeb_left)
 
config SHIELD_LIKEEB_RIGHT
    def_bool $(shields_list_contains,likeeb_right)
```

## config/boards/shields/testkb/Kconfig.sheild
```kconfig
# Copyright (c) 2022 Casey Webster, Lau Kar Rui
# SPDX-License-Identifier: MIT

config SHIELD_TESTKB
    def_bool $(shields_list_contains,testkb)
```
