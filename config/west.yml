## config/west.yml
```yaml
manifest:
  remotes:
    - name: zmkfirmware
      url-base: https://github.com/zmkfirmware
    - name: holyergo
      url-base: https://github.com/HolyErgo
  projects:
    - name: zmk
      remote: zmkfirmware
      revision: 5b51501fead672c41b5cfb396f3dafe0894bf4e9 # main on Zephyr 4.1; switch to v0.4 once released
      import: app/west.yml
    - name: likeeb-shield-module
      remote: holyergo
      revision: main
  self:
    path: config
```
